## boards/shields/nice_view_custom/Kconfig
```kconfig
config ZMK_WIDGET_MODIFIERS_DEBUG
    bool "Enable debug logging for modifiers widget"
    default n
    depends on ZMK_WIDGET_MODIFIERS 

config ZMK_DONGLE_DISPLAY_MAC_MODIFIERS
    bool "Use Mac-style modifier icons (⌘,⌥,⌃,⇧)"
    depends on ZMK_WIDGET_MODIFIERS
    help
      Use Mac-style modifier icons instead of Windows-style 
```
